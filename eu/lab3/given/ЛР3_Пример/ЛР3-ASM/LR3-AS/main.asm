;
; LR3-AS.asm
;
; Created: 02.10.2020 12:12:33
; Author : Knight
;


.include "m16def.inc" ; подключение библиотеки для работы с ATmega16
.list ; включение листинга
.def temp=r16 ; определение главного рабочего регистра
.def kold=r17
.def k___=r18
.def s___=r19
;--------------------------------------------
.cseg ; выбор сегмента программного кода
.org 0 ; установка текущего адреса на ноль
;--------------------------------------------
ldi temp,0x80 ; выключение компаратора
out acsr,temp
;--------------------------------------------
ldi temp,0x00 ; 0 --> temp
out ddrd,temp ; Назначаем порт rd на ввод (00000000 --> ddrd)
ldi temp,0xFF ; 0xff --> temp
out ddrb,temp ; Назначаем порт rb на вывод (11111111 --> ddrb)
out portd,temp ; Подключаем подтягивающие резисторы (11111111 --> portd)
;---------------------------------------------
ldi kold, 0x00 ; 0--->kold
ldi s___, 0x00 ; 0--->s___
out portb, s___ ; Вывели s___(=0)
;---------------------------------------------
read: ;
in k___, pind ; Считали содержимое порта pd (--->k___)
cp k___, kold ; Сравнили k___ и kold
breq read ; Если k___=kold, read
tst kold ; Проверили kold
brne remem ; Если kold!=0, remen
tst k___ ; Проверили k___
breq remem ; Если k___=0, remem
jmp lbl1 ;
;---------------------------------------------
remem: ;
mov kold, k___ ; Записали k___ в kold
jmp read ; Вернулись в read
;---------------------------------------------
lbl1: ;
cpi k___, 0x01 ; Сравнили k___ и 1
brne lbl2 ; Если k___!=1, lbl2
cpi s___, 0x0F ; Сравнили s___ и 15
brne lbl_1 ; Если s___!=15, lbl_1
jmp print ; Перешли на Вывод
lbl_1: ;
inc s___ ; s___+1--->s___
jmp print ; Перешли на Вывод
;---------------------------------------------
lbl2: ;
cpi k___, 0x02 ; Сравнили k___ и 2
brne lbl4 ; Если k___!=2, lbl4
MOV temp, s___ ; Перепишем состояние в буферный регистр
ANDI temp, 0x03 ; Получим остаток от деления на 4
SUB s___, temp ; Вычтем остаток из текущего состояния
jmp print ; Перешли на Вывод
;---------------------------------------------
lbl4: ;
cpi k___, 0x04 ; Сравнили k___ и 4
brne remem ; Если k___!=4, remem
MOV temp, s___ ; Перепишем состояние в буферный регистр
ANDI temp, 0x03 ; Получим остаток от деления на 4
cpi temp, 0x00 ; Сравнили остаток и 0
brne lbl_41 ; Если остаток!=0, lbl_41
cpi s___, 0x0C ; Сравнили состояние и 12
BREQ lbl_42 ; Если состояние=12, lbl_42
inc s___ ; ...
inc s___ ; ...
inc s___ ; ...
inc s___ ; s___+4--->s___
;SUBI s___, 0$FB ; Возможно, это будет работать вместо 4 инкрементов
jmp print ; Перешли на Вывод
lbl_41: ;
cpi temp, 0x03 ; Сравнили остаток и 3
brne lbl_42 ; Если остаток!=3, lbl_42
cpi s___, 0x03 ; Сравнили состояние и 3
BREQ lbl_42 ; Если состояние=3, lbl_42
SUBI s___, 0x04 ; Уменьшение состояния на 4
jmp print ; Перешли на Вывод

lbl_42: ;
jmp print ; Перешли на Вывод
;---------------------------------------------
print: ;
out portb, s___ ; Вывели s___ в порт pb
jmp remem

start:
    inc r16
    rjmp start
